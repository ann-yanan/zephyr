## arch/riscv/custom/xuantie/Kconfig
```kconfig
# Copyright (c) 2025 Alibaba
# SPDX-License-Identifier: Apache-2.0

config ARCH_RISCV_HAS_CUSTOM
    bool
    default y if DT_HAS_XUANTIE_RISCV_ENABLED
    help
      Automatically enabled when the devicetree contains a 'xuantie,riscv'
      compatible node. Used to conditionally compile Xuantie-specific code.
```

## boards/xuantie/xuantie_xiaohui_c908v/Kconfig.xuantie_xiaohui_c908v
```kconfig
# Copyright (c) 2019 BayLibre SAS
# SPDX-License-Identifier: Apache-2.0

config BOARD_XUANTIE_XIAOHUI_C908V
	select SOC_SERIES_XUANTIE_RISCV_XIAOHUI
```

## boards/xuantie/xuantie_xiaohui_c908v/board.yml
```yaml
board:
  name: xuantie_xiaohui_c908v
  vendor: xuantie
  socs:
  - name: riscv_xiaohui
    variants:
    - name: smp
```

## dts/bindings/cpu/xuantie-common.yaml
```yaml
# Copyright (c) 2025 Xuantie Technology Corporation
# SPDX-License-Identifier: Apache-2.0

# Common fields for Xuantie RISC-V CPUs

include: riscv,cpus.yaml

properties:
  hardware-exec-breakpoint-count:
    type: int
    description: Number of hardware break points
```

## soc/xuantie/riscv_family/Kconfig
```kconfig
# Configuration options for riscv SOCs supporting the riscv privileged
# architecture specification
# Copyright (c) 2017 Jean-Paul Etienne <fractalclone@gmail.com>
# Copyright (C) 2017-2024 Alibaba Group Holding Limited
# SPDX-License-Identifier: Apache-2.0
#select GEN_IRQ_VECTOR_TABLE

config SOC_FAMILY_XUANTIE_RISCV_FAMILY
	bool
    select ATOMIC_OPERATIONS_BUILTIN
 	select INCLUDE_RESET_VECTOR
	select RISCV
	select RISCV_PRIVILEGED
	select RISCV_MACHINE_TIMER

config KERNEL_ENTRY
	default "__xuantie_start"

config CPU_XUANTIE_RISCV
	bool

config XUANTIE_CPU_NAME
	string "the cpu name of xuantie"
	default "unknown"

config SOC_FAMILY
	string
	default "riscv_family"
	depends on SOC_FAMILY_XUANTIE_RISCV_FAMILY

config RISCV_HAS_PLIC
	bool "Does the SOC provide support for a Platform Level Interrupt Controller (PLIC)"
	depends on SOC_FAMILY_XUANTIE_RISCV_FAMILY
	help
	  Does the SOC provide support for a Platform Level Interrupt Controller (PLIC).

config RISCV_HAS_CLIC
	bool "Does the SOC provide support for a Core-Local Interrupt Controller (CLIC)"
	depends on SOC_FAMILY_XUANTIE_RISCV_FAMILY
	help
	  Does the SOC provide support for a Core-Local Interrupt Controller (CLIC).

config PLIC_BASE
	hex "the base addr of Platform Level Interrupt Controller (PLIC) for csi components in yocopen"
	default $(dt_nodelabel_reg_addr_hex,plic)

config RISCV_VECTORED_MODE
	bool "Should the SOC use mtvec in vectored mode"
	depends on SOC_FAMILY_XUANTIE_RISCV_FAMILY
	help
	  Should the SOC use mtvec in vectored mode

config XUANTIE_RISCV_VLENB_LEN
	int "Size(bits) of vector register."
	default 256
	depends on RISCV_SOC_CONTEXT_SAVE
	help
	  This option sets the vlen size that vector extension will be used

config XUANTIE_RISCV_RLENB_LEN
	int "Row Size(bits, actualy means xmlenb) of matrix register."
	default 256
	depends on RISCV_SOC_CONTEXT_SAVE
	help
	  This option sets the mlenb size that matrix extension will be used

if SOC_FAMILY_XUANTIE_RISCV_FAMILY

config CPU_XUANTIE_C908V
	bool "xuantie c908v"
	select 64BIT
	select RISCV_ISA_RV64I
	select RISCV_ISA_EXT_M
	select RISCV_ISA_EXT_A
	select RISCV_ISA_EXT_C
	select RISCV_ISA_EXT_ZICSR
	select RISCV_ISA_EXT_ZIFENCEI
	select RISCV_HAS_PLIC
	select RISCV_SOC_CONTEXT_SAVE
	select RISCV_SOC_HAS_GP_RELATIVE_ADDRESSING
	select CPU_XUANTIE_RISCV
	select RISCV_ALWAYS_SWITCH_THROUGH_ECALL
	select FPU
	select FPU_SHARING
	select CPU_HAS_FPU_DOUBLE_PRECISION
	select RISCV_ISA_EXT_F
	select RISCV_ISA_EXT_D

config CPU_XUANTIE_C908
	bool "xuantie c908"
	select 64BIT
	select RISCV_ISA_RV64I
	select RISCV_ISA_EXT_M
	select RISCV_ISA_EXT_A
	select RISCV_ISA_EXT_C
	select RISCV_ISA_EXT_ZICSR
	select RISCV_ISA_EXT_ZIFENCEI
	select RISCV_HAS_PLIC
	select CPU_XUANTIE_RISCV
	select RISCV_ALWAYS_SWITCH_THROUGH_ECALL
	select FPU
	select FPU_SHARING
	select CPU_HAS_FPU_DOUBLE_PRECISION
	select RISCV_ISA_EXT_F
	select RISCV_ISA_EXT_D

endif # SOC_FAMILY_XUANTIE_RISCV_FAMILY

source "soc/xuantie/riscv_family/*/Kconfig.soc"
```

## soc/xuantie/riscv_family/xiaohui/Kconfig.defconfig.series
```kconfig
# Copyright (c) 2020 Cobham Gaisler AB
# Copyright (C) 2017-2024 Alibaba Group Holding Limited
# SPDX-License-Identifier: Apache-2.0

if SOC_SERIES_XUANTIE_RISCV_XIAOHUI

config SOC_SERIES
	default "xiaohui"

config SYS_CLOCK_HW_CYCLES_PER_SEC
	default 50000000

config RISCV_MACHINE_TIMER_SYSTEM_CLOCK_DIVIDER
	default 1

config RISCV_MCAUSE_EXCEPTION_MASK
	default 0xFFF

config RISCV_SOC_INTERRUPT_INIT
	default y

config 2ND_LVL_ISR_TBL_OFFSET
	default 12

config 2ND_LVL_INTR_00_OFFSET
	default 11

config MAX_IRQ_PER_AGGREGATOR
	default 52

config NUM_IRQS
	default 64

config PMP_SLOTS
	default 16

endif
```

## soc/xuantie/riscv_family/xiaohui/Kconfig.series
```kconfig
# Copyright (c) 2020 Cobham Gaisler AB
# Copyright (C) 2017-2024 Alibaba Group Holding Limited
# SPDX-License-Identifier: Apache-2.0

config SOC_SERIES_XUANTIE_RISCV_XIAOHUI
	bool "RISC-V XUANTIE XIAOHUI FPGA Board"
	select SOC_FAMILY_XUANTIE_RISCV_FAMILY
```

## soc/xuantie/riscv_family/xiaohui/Kconfig.soc
```kconfig
# Copyright (c) 2020 Cobham Gaisler AB
# Copyright (C) 2017-2024 Alibaba Group Holding Limited
# SPDX-License-Identifier: Apache-2.0

choice
	prompt "RISC-V XUANTIE XIAOHUI FPGA Board"
	depends on SOC_SERIES_XUANTIE_RISCV_XIAOHUI

config SOC_XUANTIE_RISCV_XIAOHUI
	bool "RISC-V XUANTIE XIAOHUI FPGA Board"

endchoice
```
